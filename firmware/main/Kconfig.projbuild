## firmware/main/Kconfig.projbuild
```kconfig
menu "CryptoClock Pro"

    config CCP_DEFAULT_BROKER_URI
        string "Default MQTT broker URI"
        default "mqtt://192.168.1.100:1883"
        help
            Used until the device is claimed and a broker is provisioned
            (stored in NVS under conn/broker).

endmenu
```

## firmware/sdkconfig.defaults
```kconfig
# ---------- target ----------
CONFIG_IDF_TARGET="esp32s3"

# ---------- flash 16MB ----------
CONFIG_ESPTOOLPY_FLASHSIZE_16MB=y
CONFIG_ESPTOOLPY_FLASHMODE_QIO=y
CONFIG_ESPTOOLPY_FLASHFREQ_80M=y

# ---------- CPU ----------
CONFIG_ESP_DEFAULT_CPU_FREQ_MHZ_240=y

# ---------- PSRAM 8MB octal ----------
# Internal DIRAM is scarce (~334KB with 64KB dcache): push general mallocs,
# WiFi/LWIP buffers and the LVGL heap into PSRAM.
CONFIG_SPIRAM=y
CONFIG_SPIRAM_MODE_OCT=y
CONFIG_SPIRAM_SPEED_80M=y
CONFIG_SPIRAM_USE_MALLOC=y
CONFIG_SPIRAM_MALLOC_ALWAYSINTERNAL=512
CONFIG_SPIRAM_MALLOC_RESERVE_INTERNAL=65536
CONFIG_SPIRAM_TRY_ALLOCATE_WIFI_LWIP=y

# ---------- cache tuned for big PSRAM framebuffer traffic ----------
CONFIG_ESP32S3_DATA_CACHE_64KB=y
CONFIG_ESP32S3_DATA_CACHE_LINE_64B=y

# ---------- partitions / OTA rollback ----------
CONFIG_PARTITION_TABLE_CUSTOM=y
CONFIG_PARTITION_TABLE_CUSTOM_FILENAME="partitions.csv"
CONFIG_BOOTLOADER_APP_ROLLBACK_ENABLE=y

# ---------- system ----------
CONFIG_FREERTOS_HZ=1000
CONFIG_ESP_MAIN_TASK_STACK_SIZE=8192
CONFIG_COMPILER_OPTIMIZATION_PERF=y
CONFIG_ESP_TASK_WDT_TIMEOUT_S=10
CONFIG_ESP_COREDUMP_ENABLE_TO_FLASH=y
CONFIG_ESP_COREDUMP_DATA_FORMAT_ELF=y

# ---------- LVGL 9 (managed component Kconfig) ----------
CONFIG_LV_COLOR_DEPTH_16=y
# clib malloc -> esp malloc -> PSRAM (frees the 64KB builtin pool from .bss)
CONFIG_LV_USE_CLIB_MALLOC=y
CONFIG_LV_FONT_MONTSERRAT_14=y
CONFIG_LV_FONT_MONTSERRAT_20=y
CONFIG_LV_FONT_MONTSERRAT_28=y
CONFIG_LV_FONT_MONTSERRAT_48=y
CONFIG_LV_USE_QRCODE=y
# PNG/JPG decoders for SD-card images (slideshow, avatars, assets)
CONFIG_LV_USE_LODEPNG=y
CONFIG_LV_USE_TJPGD=y
CONFIG_LV_USE_FS_POSIX=y
CONFIG_LV_FS_POSIX_LETTER=65
CONFIG_LV_FS_POSIX_PATH=""

# ---------- WAMR (interp-only for v1; AOT arrives M7) ----------
CONFIG_WAMR_ENABLE_INTERP=y
CONFIG_WAMR_INTERP_FAST=y
CONFIG_WAMR_ENABLE_AOT=n
CONFIG_WAMR_ENABLE_LIBC_BUILTIN=y
CONFIG_WAMR_ENABLE_LIBC_WASI=n
CONFIG_WAMR_ENABLE_LIB_PTHREAD=n

# ---------- networking ----------
# TLS buffers from PSRAM — internal RAM cannot fit concurrent handshakes
CONFIG_MBEDTLS_EXTERNAL_MEM_ALLOC=y
CONFIG_ESP_WIFI_STATIC_RX_BUFFER_NUM=8
CONFIG_ESP_WIFI_DYNAMIC_RX_BUFFER_NUM=24
CONFIG_ESP_WIFI_DYNAMIC_TX_BUFFER_NUM=24
CONFIG_ESP_HTTPS_OTA_ALLOW_HTTP=y
CONFIG_ESP_HTTP_CLIENT_ENABLE_HTTPS=y
CONFIG_MBEDTLS_CERTIFICATE_BUNDLE=y
CONFIG_LWIP_SNTP_MAX_SERVERS=2

# console on the native USB port (board has no separate UART bridge)
CONFIG_ESP_CONSOLE_USB_SERIAL_JTAG=y
```
